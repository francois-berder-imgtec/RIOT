## boards/6lowpan-clicker/Kconfig
```kconfig
 # Copyright (c) 2020 Francois Berder
#
# This file is subject to the terms and conditions of the GNU Lesser
# General Public License v2.1. See the file LICENSE in the top level
# directory for more details.
#
config BOARD
    default "6lowpan-clicker" if BOARD_6LOWPAN_CLICKER

config BOARD_6LOWPAN_CLICKER
    bool
    default y
    select CPU_MODEL_PIC32MX470F512H
    select HAS_PERIPH_GPIO
    select HAS_PERIPH_GPIO_IRQ
    select HAS_PERIPH_UART
```

## cpu/mips32r2_common/Kconfig
```kconfig
# Copyright (c) 2020 Francois Berder
#
# This file is subject to the terms and conditions of the GNU Lesser
# General Public License v2.1. See the file LICENSE in the top level
# directory for more details.

config CPU_ARCH_MIPS32R2
    bool
    select HAS_ARCH_MIPS
    select HAS_ARCH_32BIT

config CPU_ARCH
    default "mips32r2" if CPU_ARCH_MIPS32R2

 ## Common CPU symbols
config CPU_CORE
    default "m4k" if CPU_CORE_M4K
    default "m5150" if CPU_CORE_M5150

config CPU_CORE_M4K
    bool
    select CPU_ARCH_MIPS32R2

config CPU_CORE_M5150
    bool
    select CPU_ARCH_MIPS32R2

config HAS_ARCH_MIPS
    bool
    help
        Indicates that the current architecture is MIPS.
```

## cpu/mips_pic32_common/Kconfig
```kconfig
# Copyright (c) 2020 Francois Berder
#
# This file is subject to the terms and conditions of the GNU Lesser
# General Public License v2.1. See the file LICENSE in the top level
# directory for more details.


config CPU_COMMON_PIC32
    bool
    select HAS_PERIPH_CPUID
    select HAS_PERIPH_GPIO
    select HAS_PERIPH_GPIO_IRQ
    select HAS_PERIPH_PM

source "$(RIOTCPU)/mips32r2_common/Kconfig"
```

## cpu/mips_pic32mx/Kconfig
```kconfig
# Copyright (c) 2020 Francois Berder
#
# This file is subject to the terms and conditions of the GNU Lesser
# General Public License v2.1. See the file LICENSE in the top level
# directory for more details.
#

config CPU_FAM_PIC32MX
    bool
    select CPU_COMMON_PIC32
    select CPU_CORE_M4K
    select HAS_CPU_PIC32MX

## CPU Models
config CPU_MODEL_PIC32MX470F512H
    bool
    select CPU_FAM_PIC32MX

config HAS_CPU_PIC32MX
    bool
    help
        Indicates that a 'PIC32MX' cpu is being used.

## Common CPU symbols
config CPU_FAM
    default "pic32mx" if CPU_FAM_PIC32MX

 config CPU_MODEL
    default 'pic32mx470f512h' if CPU_MODEL_PIC32MX470F512H

config CPU
    default "pic32mx"

source "$(RIOTCPU)/mips_pic32_common/Kconfig"
```

## cpu/mips_pic32mz/Kconfig
```kconfig
# Copyright (c) 2020 Francois Berder
#
# This file is subject to the terms and conditions of the GNU Lesser
# General Public License v2.1. See the file LICENSE in the top level
# directory for more details.

config CPU_FAM_PIC32MZ
    bool
    select CPU_COMMON_PIC32
    select CPU_CORE_M5150
    select HAS_CPU_PIC32MZ
    select HAS_PERIPH_HWRNG

## CPU Models
config CPU_MODEL_PIC32MZ2048EFG100
    bool
    select CPU_FAM_PIC32MZ

config HAS_CPU_PIC32MZ
    bool
    help
        Indicates that a 'PIC32MZ' cpu is being used.

## Common CPU symbols
config CPU_FAM
    default "pic32mz" if CPU_FAM_PIC32MZ

 config CPU_MODEL
    default 'pic32mz2048efg100' if CPU_MODEL_PIC32MZ2048EFG100

config CPU
    default "pic32mz"

source "$(RIOTCPU)/mips_pic32_common/Kconfig"
```
